## build/conf/bblayers.conf
```bitbake
# LAYER_CONF_VERSION is increased each time build/conf/bblayers.conf
# changes incompatibly
LCONF_VERSION = "6"

BBPATH = "${TOPDIR}"
BSPDIR := "${@os.path.abspath(os.path.dirname(d.getVar('FILE', True)) + '/../..')}"
BBFILES ?= ""

BBLAYERS ?= " \
  ${BSPDIR}/sources/poky/meta \
  ${BSPDIR}/sources/poky/meta-yocto \
  ${BSPDIR}/sources/poky/meta-yocto-bsp \
  ${BSPDIR}/sources/meta-lantronix \
  ${BSPDIR}/sources/meta-openembedded/meta-oe \
  ${BSPDIR}/sources/meta-openembedded/meta-filesystems \
  ${BSPDIR}/sources/meta-openembedded/meta-networking \
  ${BSPDIR}/sources/meta-openembedded/meta-python \
  ${BSPDIR}/sources/meta-openembedded/meta-webserver \
  ${BSPDIR}/sources/meta-application \
  ${BSPDIR}/sources/meta-java \
  "
```

## sources/meta-application/conf/layer.conf
```bitbake
# We have a conf and classes directory, add to BBPATH
BBPATH .= ":${LAYERDIR}"

# We have a recipes-* directories, add to BBFILES
BBFILES += "${LAYERDIR}/recipes-*/*/*.bb \
            ${LAYERDIR}/recipes-*/*/*.bbappend"

BBFILE_COLLECTIONS += "meta-application"
BBFILE_PATTERN_meta-application = "^${LAYERDIR}/"
BBFILE_PRIORITY_meta-application = "101"
```

## sources/meta-lantronix/conf/machine/pw2050.conf
```bitbake
#@TYPE: Machine
#@NAME: pw2050

#@DESCRIPTION: Machine configuration for PW2050

MACHINE_EXTRA_RRECOMMENDS = " kernel-modules kernel-devicetree"

include conf/machine/include/tune-arm926ejs.inc

MKUBIFS_ARGS = "-e 0x1f000 -c 2048 -m 0x800 -x lzo"
IMAGE_CLASSES += "image_types_ltrx"
IMAGE_FSTYPES += "tar.gz ubifs rom"

SERIAL_CONSOLES = "115200;ttyGS0"

PREFERRED_PROVIDER_virtual/kernel ?= "linux-yocto-custom"

KERNEL_IMAGETYPE = "zImage"
KERNEL_DEVICETREE = "ltrx_at9g252-q2.dtb"
UBOOT_MACHINE = "at91sam9g20ek_nandflash_config"

MACHINE_FEATURES = "usbgadget usbhost vfat alsa"

# use GCC 4.8 - kernel does not support building with GCC 5
GCCVERSION = "4.8%"

LTRX_BOARD_NAME = "golden_gate"
LTRX_PRODUCT_LONG_NAME = "Lantronix PremierWave 2050"
LTRX_PRODUCT_SHORT_NAME = "PW2050"
LTRX_PRODUCT_VERSION = "8.1.0.3R10"
LTRX_PRODUCT_FAMILY_ID = "NUEVO-2"
LTRX_PRODUCT_CODE = "Q2"
LTRX_KERNEL_IMAGE_TYPE = "4"
LTRX_ROOTFS_IMAGE_TYPE = "13"
LTRX_BASE_ADDRESS = "0x20008000"
LTRX_KERNEL_MACHINE = "PW2050"
```

## sources/meta-lantronix/conf/machine/sgx5150.conf
```bitbake
#@TYPE: Machine
#@NAME: sgx5150

#@DESCRIPTION: Machine configuration for SGX5150

MACHINE_EXTRA_RRECOMMENDS = " kernel-modules kernel-devicetree"

include conf/machine/include/tune-arm926ejs.inc

MKUBIFS_ARGS = "-e 0x1f000 -c 2048 -m 0x800 -x lzo"
IMAGE_CLASSES += "image_types_ltrx"
IMAGE_FSTYPES += "tar.gz ubifs rom"

SERIAL_CONSOLES = "115200;ttyGS0"

PREFERRED_PROVIDER_virtual/kernel ?= "linux-yocto-custom"

KERNEL_IMAGETYPE = "zImage"
KERNEL_DEVICETREE = "ltrx_at9g252-q4.dtb"
UBOOT_MACHINE = "at91sam9g20ek_nandflash_config"

MACHINE_FEATURES = "usbgadget usbhost vfat alsa"

# use GCC 4.8 - kernel does not support building with GCC 5
GCCVERSION = "4.8%"

LTRX_BOARD_NAME = "plastic_portal"
LTRX_PRODUCT_LONG_NAME = "Lantronix SGX5150"
LTRX_PRODUCT_SHORT_NAME = "SGX5150"
LTRX_PRODUCT_VERSION = "8.2.0.3R9"
LTRX_PRODUCT_FAMILY_ID = "NUEVO-2"
LTRX_PRODUCT_CODE = "Q4"
LTRX_KERNEL_IMAGE_TYPE = "4"
LTRX_ROOTFS_IMAGE_TYPE = "13"
LTRX_BASE_ADDRESS = "0x20008000"
LTRX_KERNEL_MACHINE = "SGX5150"
```
